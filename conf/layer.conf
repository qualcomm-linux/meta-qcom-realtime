## conf/layer.conf
```bitbake
# We have a conf and classes directory, add to BBPATH
BBPATH .= ":${LAYERDIR}"

# We have a packages directory, add to BBFILES
BBFILES += "${LAYERDIR}/recipes-*/*/*.bb \
            ${LAYERDIR}/recipes-*/*/*.bbappend"

# Providers for RT kernel
PREFERRED_PROVIDER_virtual/kernel:qcom-custom-bsp = "linux-qcom-custom-rt"
PREFERRED_PROVIDER_virtual/kernel:qcom-base-bsp   = "linux-qcom-base-rt"

# RT Kernel recipes reuse same DT as non RT Kernel recipes.
KERNEL_DEVICETREE:pn-linux-qcom-base-rt = "${KERNEL_DEVICETREE:pn-linux-qcom-base}"
KERNEL_DEVICETREE:pn-linux-qcom-mergedtb:qcom-base-bsp = "${KERNEL_DEVICETREE:pn-linux-qcom-base}"
KERNEL_DEVICETREE:pn-linux-qcom-custom-rt = "${KERNEL_DEVICETREE:pn-linux-qcom-custom}"
KERNEL_DEVICETREE:pn-linux-qcom-mergedtb:qcom-custom-bsp = "${KERNEL_DEVICETREE:pn-linux-qcom-custom}"

IMAGE_INSTALL:append = " rt-tests numactl stress-ng libcgroup libgcrypt"

# Default serial console for QCOM devices
SERIAL_CONSOLES = "115200;ttyMSM0"

# Additional Kernel cmdline parameters for debug builds
DBG_CMDLINE = "${@oe.utils.conditional('DEBUG_BUILD','1','earlycon reboot=panic_warm page_owner=on qcom_scm.download_mode=1 slub_debug=FZP,zs_handle,zspage;FZPU','',d)}"

# Kernel command line
KERNEL_CMDLINE_EXTRA:qcs9100 = "pcie_pme=nomsi net.ifnames=0 pci=noaer kpti=off kasan=off kasan.stacktrace=off swiotlb=128 mitigations=auto kernel.sched_pelt_multiplier=4 rcupdate.rcu_expedited=1 rcu_nocbs=7 isolcpus=7 irqaffinity=0-6 no-steal-acc vfio_iommu_type1.allow_unsafe_interrupts=1 fw_devlink.strict=1 cpuidle.off=1 ${DBG_CMDLINE}"

KERNEL_CMDLINE_EXTRA:qcm6490 = "pcie_pme=nomsi net.ifnames=0 pci=noaer kpti=off kasan=off kasan.stacktrace=off swiotlb=128 mitigations=auto kernel.sched_pelt_multiplier=4 rcupdate.rcu_expedited=1 rcu_nocbs=7 isolcpus=7 irqaffinity=0-6 no-steal-acc vfio_iommu_type1.allow_unsafe_interrupts=1 cpuidle.off=1 ${DBG_CMDLINE}"

KERNEL_CMDLINE_EXTRA:qcs8300 = "pcie_pme=nomsi net.ifnames=0 pci=noaer kpti=off kasan=off kasan.stacktrace=off swiotlb=128 mitigations=auto kernel.sched_pelt_multiplier=4 rcupdate.rcu_expedited=1 rcu_nocbs=3 isolcpus=3 irqaffinity=0-2,4-7 no-steal-acc arm64.nopauth cpuidle.off=1 ${DBG_CMDLINE}"

BBFILE_COLLECTIONS      += "qcom-realtime"
BBFILE_PATTERN_qcom-realtime   = "^${LAYERDIR}/"
BBFILE_PRIORITY_qcom-realtime  = "12"

LAYERSERIES_COMPAT_qti-realtime = "kirkstone scarthgap"
```
